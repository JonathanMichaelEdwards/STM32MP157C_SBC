## src/yocto-app/build-mp1/conf/bblayers.conf
```bitbake
# POKY_BBLAYERS_CONF_VERSION is increased each time build/conf/bblayers.conf
# changes incompatibly
POKY_BBLAYERS_CONF_VERSION = "2"

BBPATH = "${TOPDIR}"
BBFILES ?= ""

BBLAYERS_PATH = "/home/jonathan/Desktop/Embedded_Systems/Software/apps/LUCY-II-yocto-odyssey"
BBLAYERS ?= " \
  ${BBLAYERS_PATH}/poky/meta \
  ${BBLAYERS_PATH}/poky/meta-poky \
  ${BBLAYERS_PATH}/poky/meta-yocto-bsp \
  ${BBLAYERS_PATH}/meta-openembedded/meta-oe \ 
  ${BBLAYERS_PATH}/meta-openembedded/meta-python \
  ${BBLAYERS_PATH}/meta-python2 \
  ${BBLAYERS_PATH}/meta-st-stm32mp \
  ${BBLAYERS_PATH}/meta-st-odyssey \
  ${BBLAYERS_PATH}/meta-custom \
  "
```

## src/yocto-app/meta-st-odyssey/conf/layer.conf
```bitbake
# We have a conf and classes directory, add to BBPATH
BBPATH .= ":${LAYERDIR}"

# We have recipes-* directories, add to BBFILES
BBFILES += "${LAYERDIR}/recipes-*/*/*.bb \
            ${LAYERDIR}/recipes-*/*/*.bbappend"

BBFILE_COLLECTIONS += "meta-st-odyssey"
BBFILE_PATTERN_meta-st-odyssey = "^${LAYERDIR}/"
BBFILE_PRIORITY_meta-st-odyssey = "6"

LAYERDEPENDS_meta-st-odyssey = "core"
LAYERSERIES_COMPAT_meta-st-odyssey = "dunfell"


#
# For support meta-st-odyssey layer
#
#

# Add device tree file to support ODYSSEY som
#STM32MP_DT_FILES_ODYSSEY = "stm32mp157c-odyssey"
#STM32MP_DEVICETREE += " ${STM32MP_DT_FILES_ODYSSEY} "
#UBOOT_EXTLINUX_TARGETS_EXTRA_CONFIG_target-emmc += "${STM32MP_DT_FILES_ODYSSEY}"

# =========================================================================
# Device Storage
# =========================================================================
# Enable the board device storage support with STM32MP_DT_FILES_ODYSSEY according to BOOTDEVICE_LABELS
#DEVICE_BOARD_ENABLE_EMMC += " ${@bb.utils.contains('BOOTDEVICE_LABELS', 'emmc', '${STM32MP_DT_FILES_ODYSSEY}', '', d)} "


# =========================================================================
# Flashlayout
# =========================================================================
# Set the FLASHLAYOUT_TYPE_LABELS to STM32MP_DT_FILES_ODYSSEY according to BOOTDEVICE_LABELS
#FLASHLAYOUT_TYPE_LABELS_emmc = "{STM32MP_DT_FILES_ODYSSEY}"

#MACHINE_FEATURES += " ${@bb.utils.contains_any('BOOTDEVICE_LABELS',  '${STM32MP_DT_FILES_ODYSSEY}', 'autoresize', '', d) "
```
